## dts/bindings/dfpmcch/intel,adsp-dfpmcch.yaml
```yaml
# Copyright (c) 2022 Intel Corporation
#
# SPDX-License-Identifier: Apache-2.0

description: Intel ADSP Power Management / Clock Control (HST) registers

compatible: "intel,adsp-dfpmcch"

include: base.yaml

properties:
    reg:
      required: true
```
